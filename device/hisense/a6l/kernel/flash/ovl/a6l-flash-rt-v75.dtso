// SPDX-License-Identifier: GPL-2.0-only
// A6L flash/torch - RUNTIME (attended test) variant of a6l-flash-v75.dtso, embedded in a6l_flash_ovl.ko.
// Same node/channel as the ROM overlay (PM660L qcom,leds@d300 = mainline pm660l_flash, stock flash_0/torch_0
// = HW channel 0 = mainline led-sources <1>). Limits for the test:
//   torch: led-max-microamp = stock torch_0 max (500 mA); brightness 1..255 maps linearly to 0..500 mA,
//          run-flash.sh writes a LOW value (default 25 mA) unless LEVEL=max is given explicitly.
//   flash: flash-max-microamp 500 mA (stock max 1500 mA), flash-max-timeout 100 ms (stock default 1280 ms).
/dts-v1/;
/plugin/;
#include <dt-bindings/leds/common.h>

&pm660l_flash {
	status = "okay";

	led-0 {
		function = LED_FUNCTION_FLASH;
		color = <LED_COLOR_ID_WHITE>;
		led-sources = <1>;
		led-max-microamp = <500000>;
		flash-max-microamp = <500000>;
		flash-max-timeout-us = <100000>;
	};
};
