// SPDX-License-Identifier: GPL-2.0-only
// V75 CANDIDATE (ipa agent, 24 Sep 2026), never booted. Mobile data: IPA v2.6L on SDM660 with the ipa2-lite driver
// (Vladimir Lypak / Sireesh Kodali, msm8953-mainline 7.1.3/main drivers/net/ipa2-lite; A6L port = ipa2_lite.ko).
// Supersedes the kvoice ipa-legacy overlay (ipa@147c0000 + private BAM): do NOT apply both (overlapping registers).
// From stock DT (firmware/extracted/device-trees/stock-00.dts, qcom,ipa@14780000):
//   reg ipa-base 0x14780000/0x4effc (BAM at +0x4000 = stock "bam-base" 0x14784000, IPA regs at +0x40000,
//   IPA SRAM/uC mailbox at +0x45000; ipa2-lite uses one region and fixed offsets = downstream ipa_reg.h v2.5/v2.6L),
//   ipa-irq SPI 333, bam-irq SPI 432 (trigger types as in the msm8953 ipa2-lite node), core_clk = RPM IPA clock,
//   ipa_smmu_ap = anoc2 SMMU SID 0x19c0 (stock: S1 bypass; here: translated through the DMA API),
//   msm-bus "ipa" SVS vector IPA->EBI (ab 80000 / ib 640000 KBps; the driver votes it via "memory").
/dts-v1/;
/plugin/;

/ {
    fragment@0 {
        target-path = "/soc@0";
        __overlay__ {
            #address-cells = <1>;
            #size-cells = <1>;

            a6l_ipa: ipa@14780000 {
                compatible = "qcom,sdm660-ipa-lite", "qcom,ipa-lite-v2.6";
                reg = <0x14780000 0x4f000>;
                interrupts = <0 333 1>,                     /* GIC_SPI 333 IRQ_TYPE_EDGE_RISING */
                             <0 432 4>;                     /* GIC_SPI 432 IRQ_TYPE_LEVEL_HIGH */
                interrupt-names = "ipa", "dma";
                clocks = <&rpmcc 68>;                       /* RPM_SMD_IPA_CLK */
                interconnects = <&a2noc 0 &bimc 5>;         /* MASTER_IPA -> SLAVE_EBI */
                interconnect-names = "memory";
                /* A6L ipa2fix noiommu variant: no iommus (register steps only) */
                modem-remoteproc = <&remoteproc_mss>;
            };
        };
    };
    fragment@1 { target-path = "/chosen"; __overlay__ { hisense,a6l-ipa = "ipa2-lite-v75-noiommu"; }; };
};
